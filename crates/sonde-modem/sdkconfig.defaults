## crates/sonde-modem/sdkconfig.defaults
```kconfig
# SPDX-License-Identifier: MIT
# Copyright (c) 2026 sonde contributors
#
# ESP-IDF configuration for sonde-modem firmware.
#
# Console output goes to UART0 (the USB-UART bridge chip on most dev
# boards) so that log::info!/warn! traces do not interfere with the
# binary modem protocol running on the native USB-CDC port (GPIO19/20).
#
# On a typical ESP32-S3-DevKitC-1:
#   UART port  → diagnostic logs (idf.py monitor / 115200 baud)
#   USB port   → modem protocol (gateway serial link)
#
# NOTE: Bluetooth / NimBLE settings live in the workspace-root
# sdkconfig.defaults.esp32s3 (chip-specific suffix).  esp-idf-sys
# resolves sdkconfig paths relative to the workspace root, so settings
# placed here are NOT picked up by the build — keep BT config there.

# --- Console ---
CONFIG_ESP_CONSOLE_UART_DEFAULT=y
CONFIG_ESP_CONSOLE_UART_NUM=0
CONFIG_ESP_CONSOLE_UART_BAUDRATE=115200

# --- Watchdog (MD-0302) ---
CONFIG_ESP_TASK_WDT_EN=y
CONFIG_ESP_TASK_WDT_TIMEOUT_S=10
CONFIG_ESP_TASK_WDT_PANIC=y

# --- Logging ---
CONFIG_LOG_DEFAULT_LEVEL_INFO=y
CONFIG_LOG_MAXIMUM_LEVEL_DEBUG=y

# --- WiFi / ESP-NOW ---
CONFIG_ESP_WIFI_ENABLED=y
```

## crates/sonde-node/sdkconfig.defaults
```kconfig
# SPDX-License-Identifier: MIT
# Copyright (c) 2026 sonde contributors
#
# Default SDK configuration for the sonde-node ESP32-C3 firmware.
# Optimised for QEMU smoke testing while remaining compatible with real hardware.

# Flash configuration — must match the QEMU MTD drive (DIO mode, 40 MHz, 4 MB).
CONFIG_ESPTOOLPY_FLASHMODE_DIO=y
CONFIG_ESPTOOLPY_FLASHFREQ_40M=y
CONFIG_ESPTOOLPY_FLASHSIZE_4MB=y

# Use the built-in "Single factory app (large), no OTA" partition table.
# This provides ~1.5 MB for the app partition (vs 1 MB in the default).
CONFIG_PARTITION_TABLE_SINGLE_APP_LARGE=y

# Serial console on UART0 at 115200 bps (QEMU forwards UART0 to stdio).
# Explicitly disable USB Serial/JTAG console so UART0 is used in QEMU.
# On ESP32-C3, the secondary USB Serial/JTAG console is enabled by
# Kconfig default; the pairing mode driver detects and reuses it.
CONFIG_ESP_CONSOLE_UART_DEFAULT=y
CONFIG_ESP_CONSOLE_UART_NUM=0
CONFIG_ESP_CONSOLE_UART_BAUDRATE=115200
CONFIG_ESP_CONSOLE_USB_SERIAL_JTAG_ENABLED=n

# Log level: DEBUG for development. Change to INFO for production.
CONFIG_LOG_DEFAULT_LEVEL_DEBUG=y

# Size optimizations — reduce firmware binary size.
CONFIG_COMPILER_OPTIMIZATION_SIZE=y
CONFIG_COMPILER_OPTIMIZATION_ASSERTIONS_SILENT=y

# Main task stack size — increased from default (3584) to 16 KB
# (ND-0918).  The primary driver is BLE stack initialization
# (NimBLE host + GATT server setup in run_ble_pairing_mode); NVS,
# ESP-NOW, and BPF interpreter also contribute.
CONFIG_ESP_MAIN_TASK_STACK_SIZE=16384

# FreeRTOS tick rate — pinned to 1000 Hz (1 ms/tick).
# The ESP pairing serial driver's ms_to_ticks() depends on this value.
CONFIG_FREERTOS_HZ=1000

# Disable unused WiFi features to reduce binary size.
# The node only needs STA mode for ESP-NOW.
CONFIG_ESP_WIFI_SOFTAP_SUPPORT=n
CONFIG_ESP_WIFI_ENTERPRISE_SUPPORT=n

# --- Bluetooth / NimBLE (ND-0902) ---
# Use NimBLE (BLE-only, lightweight) instead of Bluedroid.
# esp32-nimble requires CONFIG_BT_NIMBLE_ENABLED=y so that esp-idf-sys
# picks up and generates NimBLE bindings.
CONFIG_BT_ENABLED=y
CONFIG_BT_BLE_ENABLED=y
CONFIG_BT_BLUEDROID_ENABLED=n
CONFIG_BT_NIMBLE_ENABLED=y
# NimBLE host task stack size — increased for GATT server workload.
CONFIG_BT_NIMBLE_HOST_TASK_STACK_SIZE=7000
# Pin NimBLE host task to Core 0.  On the dual-core ESP32-S3, NimBLE
# defaults to Core 1 which crashes during init; the unicore ESP32-C3
# runs everything on Core 0 regardless, but setting this explicitly
# keeps the configuration consistent with sdkconfig.defaults.esp32s3.
CONFIG_BT_NIMBLE_PINNED_TO_CORE_0=y
# Disable NVS bond persistence — the provisioning protocol does
# not rely on persistent BLE bonds.
CONFIG_BT_NIMBLE_NVS_PERSIST=n
```

## sdkconfig.defaults.esp32s3
```kconfig
# SPDX-License-Identifier: MIT
# Copyright (c) 2026 sonde contributors
#
# ESP-IDF configuration for ESP32-S3 (sonde-modem) firmware.
#
# esp-idf-sys resolves sdkconfig.defaults paths relative to the workspace root.
# Placing settings in a chip-specific suffix file ensures they are applied only
# for ESP32-S3 builds, not for the ESP32-C3 sonde-node build.

# --- Console ---
# Console output on UART0 so that log traces do not interfere with the
# binary modem protocol running on the native USB-CDC port (GPIO19/20).
CONFIG_ESP_CONSOLE_UART_DEFAULT=y
CONFIG_ESP_CONSOLE_UART_NUM=0
CONFIG_ESP_CONSOLE_UART_BAUDRATE=115200

# --- Watchdog ---
CONFIG_ESP_TASK_WDT_EN=y
CONFIG_ESP_TASK_WDT_TIMEOUT_S=10
CONFIG_ESP_TASK_WDT_PANIC=y

# --- Logging ---
CONFIG_LOG_DEFAULT_LEVEL_INFO=y
CONFIG_LOG_MAXIMUM_LEVEL_DEBUG=y

# --- WiFi / ESP-NOW ---
CONFIG_ESP_WIFI_ENABLED=y

# --- Flash configuration ---
# Pin flash parameters so elf2image in CI uses matching values.
CONFIG_ESPTOOLPY_FLASHMODE_DIO=y
CONFIG_ESPTOOLPY_FLASHFREQ_80M=y
CONFIG_ESPTOOLPY_FLASHSIZE_16MB=y

# --- Bluetooth / NimBLE (MD-0400) ---
# Use NimBLE (BLE-only, lightweight) instead of Bluedroid.
# Required for the Gateway Pairing Service GATT server.
# These settings must be at the workspace root so that esp-idf-sys picks them
# up and generates NimBLE bindings (host/ble_hs.h, nimble/nimble_port.h, etc.)
# which esp32-nimble requires.
CONFIG_BT_ENABLED=y
CONFIG_BT_BLE_ENABLED=y
CONFIG_BT_BLUEDROID_ENABLED=n
CONFIG_BT_NIMBLE_ENABLED=y
# NimBLE host task stack size — increased for GATT server workload.
CONFIG_BT_NIMBLE_HOST_TASK_STACK_SIZE=8192
# Pin NimBLE host task to Core 0.  On the dual-core ESP32-S3, NimBLE
# defaults to Core 1 which crashes with InstrFetchProhibited during
# init.  The unicore ESP32-C3 runs NimBLE on Core 0 without issue.
CONFIG_BT_NIMBLE_PINNED_TO_CORE_0=y
# Store bonding keys in NVS for persistent pairing.
# Disabled so that unapproved bonds (from the tentative on_confirm_pin accept)
# are never persisted.  Each pairing session is independent; the gateway does
# not rely on persistent BLE bonds.
CONFIG_BT_NIMBLE_NVS_PERSIST=n
```
